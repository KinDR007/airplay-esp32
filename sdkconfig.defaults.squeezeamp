## sdkconfig.defaults.squeezeamp
```kconfig
# SqueezeAMP defaults
CONFIG_BOARD_SQUEEZEAMP=y
CONFIG_ESPTOOLPY_FLASHSIZE_8MB=y
CONFIG_ESPTOOLPY_FLASHSIZE="8MB"
CONFIG_DAC_TAS57XX=y
CONFIG_TAS57XX_MAX_VOLUME=-20

# Spotify Connect (cspot) requires C++ exceptions, which break the linker on
# Xtensa toolchain 14.2 (missing __eh_frame). Disable here — classic ESP32
# environments do AirPlay + A2DP only. Spotify Connect: use ESP32-S3 or P4.
CONFIG_SPOTIFY_CONNECT_ENABLE=n
CONFIG_DAC_CONTROLS_VOLUME=y

# GPIO defaults
CONFIG_BAT_CHANNEL=7
CONFIG_LED_STATUS_GPIO=12
CONFIG_LED_ERROR_GPIO=13
CONFIG_I2S_BCK_IO=33
CONFIG_I2S_WS_IO=25
CONFIG_I2S_DO_IO=32
CONFIG_DAC_I2C_SDA=27
CONFIG_DAC_I2C_SCL=26
CONFIG_JACK_GPIO=34
CONFIG_SPKFAULT_GPIO=2
CONFIG_MUTE_GPIO=14
CONFIG_MUTE_GPIO_LEVEL=0
CONFIG_SPDIF_DO_IO=15

# Platform Configuration
CONFIG_LED_STATUS_BRIGHTNESS=80
CONFIG_LED_STATUS_PLAYING_STEADY=y
CONFIG_LED_STATUS_PAUSED_BLINK_MEDIUM=y
CONFIG_LED_STATUS_STANDBY_BLINK_SLOW=y
```

## sdkconfig.defaults.wrover
```kconfig
# Freenove ESP32 Wrover 4MB Devboard
CONFIG_BOARD_ESP32_GENERIC=y
CONFIG_ESPTOOLPY_FLASHSIZE_4MB=y
CONFIG_ESPTOOLPY_FLASHSIZE="4MB"
CONFIG_PARTITION_TABLE_CUSTOM_FILENAME="components/boards/partitions-4m.csv"

# Heap poisoning — kept on for the dev board so OOB writes and use-after-
# free are caught at the point of the bad access.  Costs ~9 bytes per
# allocation and some CPU; production builds leave it
# disabled.
CONFIG_HEAP_POISONING_COMPREHENSIVE=y

# GPIO defaults
CONFIG_I2S_BCK_IO=33
CONFIG_I2S_WS_IO=25
CONFIG_I2S_DO_IO=32
# PCM5102A soft-mute (XSMT) on GPIO26 — wire XSMT here instead of 3V3. Firmware
# mutes the DAC while idle / on pause / disconnect (click-free), killing the
# line-out hiss into the amp.
CONFIG_DAC_SOFT_MUTE_GPIO=26
CONFIG_DAC_I2C_SDA=-1
CONFIG_DAC_I2C_SCL=-1
CONFIG_SPDIF_DO_IO=-1
CONFIG_DISPLAY_ENABLED=y
CONFIG_DISPLAY_I2C_SDA=13
CONFIG_DISPLAY_I2C_SCL=14

# Platform Configuration
CONFIG_LED_STATUS_BRIGHTNESS=80
CONFIG_LED_STATUS_PLAYING_STEADY=y
CONFIG_LED_STATUS_PAUSED_BLINK_MEDIUM=y
CONFIG_LED_STATUS_STANDBY_BLINK_SLOW=y

#
# Display Configuration
#
#CONFIG_DISPLAY_ENABLED=y
#CONFIG_DISPLAY_DRIVER_SSD1306=y
#CONFIG_DISPLAY_HEIGHT_64=y
#CONFIG_DISPLAY_BUS_SPI=y
#CONFIG_DISPLAY_SPI_CLK=14
#CONFIG_DISPLAY_SPI_MOSI=13
#CONFIG_DISPLAY_SPI_CS=5
#CONFIG_DISPLAY_SPI_DC=12
#CONFIG_DISPLAY_SPI_RST=26
#CONFIG_DISPLAY_UPDATE_MS=500


# Use boot button for mute / play pause
CONFIG_BTN_PLAY_PAUSE_GPIO=0
# Spotify Connect (cspot) needs C++ exceptions, which are broken on the
# classic ESP32 (Xtensa LX6) 14.2 toolchain. Disable on this classic target;
# use an S3/P4 build for Spotify.
CONFIG_SPOTIFY_CONNECT_ENABLE=n

# Now-playing web UI (/nowplaying + REST API + artwork). Try to fit it in the
# 4 MB layout; if the app overflows the OTA slot the build switches to the
# single-app 4 MB partition (see platformio.ini esp32wrover-dev).
CONFIG_NOWPLAYING_UI_ENABLE=y
```

## sdkconfig.defaults.xiao-s3
```kconfig
# XIAO ESP32-S3 overrides on top of sdkconfig.defaults.esp32s3.
# 8 MB flash, 8 MB PSRAM.

CONFIG_ESPTOOLPY_FLASHSIZE_8MB=y
CONFIG_ESPTOOLPY_FLASHSIZE="8MB"

# Disable Spotify Connect — PIO ESP-IDF platform mangles cspot compile defines
# (BELL_ONLY_CJSON et al.), making cspot fail to build here. Use ESP32-P4 if
# you need Spotify Connect.
CONFIG_SPOTIFY_CONNECT_ENABLE=n

# DLNA / UPnP MediaRenderer disabled — keep this target AirPlay-only.
CONFIG_DLNA_RENDERER_ENABLE=n

# Now-playing web UI (/nowplaying page + REST API + 256 KB PSRAM artwork cache).
# Off by default; plenty of headroom on the XIAO's 8 MB flash / 8 MB PSRAM.
CONFIG_NOWPLAYING_UI_ENABLE=y

# I2S pins for the PCM5102A DAC. The default S3 pins (11/12/13) are NOT broken
# out on the XIAO ESP32-S3, so remap to exposed pads:
#   BCK -> GPIO2 (pad D1), WS/LRCK -> GPIO3 (pad D2), DOUT/DIN -> GPIO4 (pad D3)
CONFIG_I2S_BCK_IO=2
CONFIG_I2S_WS_IO=3
CONFIG_I2S_DO_IO=4

# PCM5102A soft-mute (XSMT) on GPIO6 (pad D5). Firmware mutes the DAC while idle
# and on disconnect/pause and unmutes on play — click-free via the DAC's analog
# ramp. Wire XSMT to D5 instead of 3V3.
CONFIG_DAC_SOFT_MUTE_GPIO=6

# Attenuate the line-out — the PCM5102A full-scale is too hot for the amp even
# at low AirPlay volume. 10 = full AirPlay volume ≈ 1/10 of full scale, so the
# whole iPhone slider stays usable. Raise toward 100 if too quiet.
CONFIG_OUTPUT_GAIN_PERCENT=10
```
